/*###ICF### Set of symbols used in SE and BFU projects ****/

/* Slots must be aligned on sector size */

/* swap region (4 kbytes) */
define exported symbol  __ICFEDIT_SWAP_start__             = 0x08015000;
define exported symbol  __ICFEDIT_SWAP_end__               = 0x08015FFF;

/* Dwl slot #1 (80 kbytes) */
define exported symbol  __ICFEDIT_SLOT_Dwl_1_start__       = 0x08016000;
define exported symbol  __ICFEDIT_SLOT_Dwl_1_end__         = 0x08029FFF;

/* Active slot #1 (80 Kbytes) */
define exported symbol  __ICFEDIT_SLOT_Active_1_start__    = 0x0802A000;
define exported symbol  __ICFEDIT_SLOT_Active_1_end__      = 0x0803DFFF;
define exported symbol  __ICFEDIT_SLOT_Active_1_header__   = __ICFEDIT_SLOT_Active_1_start__;

/***** NVM FLASH Data *****/
/* WARNING: Symbols not used. The NVMS address is defined in lora_app.c */
define exported symbol __ICFEDIT_region_LW_NVM_ROM_start__ = 0x0803F000;
define exported symbol __ICFEDIT_region_LW_NWM_ROM_end__   = 0x0803FFFF;

/* Slots not configured */
define exported symbol  __ICFEDIT_SLOT_Active_2_header__   = 0x00000000;
define exported symbol  __ICFEDIT_SLOT_Active_2_start__    = 0x00000000;
define exported symbol  __ICFEDIT_SLOT_Active_2_end__      = 0x00000000;
define exported symbol  __ICFEDIT_SLOT_Active_3_header__   = 0x00000000;
define exported symbol  __ICFEDIT_SLOT_Active_3_start__    = 0x00000000;
define exported symbol  __ICFEDIT_SLOT_Active_3_end__      = 0x00000000;
define exported symbol  __ICFEDIT_SLOT_Dwl_2_start__       = 0x00000000;
define exported symbol  __ICFEDIT_SLOT_Dwl_2_end__         = 0x00000000;
define exported symbol  __ICFEDIT_SLOT_Dwl_3_start__       = 0x00000000;
define exported symbol  __ICFEDIT_SLOT_Dwl_3_end__         = 0x00000000;
