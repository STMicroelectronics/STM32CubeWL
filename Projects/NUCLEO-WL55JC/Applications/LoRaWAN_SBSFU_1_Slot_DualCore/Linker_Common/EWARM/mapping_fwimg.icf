/*###ICF### Set of symbols used in SE and SB_SFU projects ****/

/* Slots  must be aligned on 2048 bytes (0x800) */

/* Slot download 1 region (2 kbytes) */
define exported symbol  __ICFEDIT_SLOT_Blob_Dwl_1_start__  = 0x08002800;
define exported symbol  __ICFEDIT_SLOT_Blob_Dwl_1_end__    = 0x08002FFF;

/* Active slot #2 (96 kbytes) */
define exported symbol  __ICFEDIT_SLOT_Active_2_header__   = 0x0803F000;
define exported symbol  __ICFEDIT_SLOT_Active_2_start__    = 0x08003000;
define exported symbol  __ICFEDIT_SLOT_Active_2_end__      = 0x0801AFFF;

/***** NVM FLASH Data *****/
/* WARNING: Symbols not used. The NVMS address is defined in lora_app.c */
define exported symbol __ICFEDIT_region_LW_NVM_ROM_start__ = 0x0801B000;
define exported symbol __ICFEDIT_region_LW_NWM_ROM_end__   = 0x0801BFFF;

/* Active slot #1 (58 kbytes) */
define exported symbol  __ICFEDIT_SLOT_Active_1_header__   = 0x0803F800;
define exported symbol  __ICFEDIT_SLOT_Active_1_start__    = 0x0801C000;
define exported symbol  __ICFEDIT_SLOT_Active_1_end__      = 0x0802A7FF;

/* Slots not configured */
define exported symbol  __ICFEDIT_SLOT_Active_3_header__   = 0x00000000;
define exported symbol  __ICFEDIT_SLOT_Active_3_start__    = 0x00000000;
define exported symbol  __ICFEDIT_SLOT_Active_3_end__      = 0x00000000;
