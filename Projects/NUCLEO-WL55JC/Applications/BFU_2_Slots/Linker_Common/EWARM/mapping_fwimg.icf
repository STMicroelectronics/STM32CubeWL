/*###ICF### Set of symbols used in SE and BFU projects ****/

/* Slots must be aligned on sector size */

/* swap region (4 kbytes) */
define exported symbol  __ICFEDIT_SWAP_start__  = 0x08015000;
define exported symbol  __ICFEDIT_SWAP_end__    = 0x08015FFF;

/* Active slot #1 (84 Kbytes) */
define exported symbol  __ICFEDIT_SLOT_Active_1_start__ = 0x0802B000;
define exported symbol  __ICFEDIT_SLOT_Active_1_end__   = 0x0803FFFF;
define exported symbol  __ICFEDIT_SLOT_Active_1_header__= __ICFEDIT_SLOT_Active_1_start__;

/* Dwl slot #1 (84 kbytes) */
define exported symbol  __ICFEDIT_SLOT_Dwl_1_start__    = 0x08016000;
define exported symbol  __ICFEDIT_SLOT_Dwl_1_end__      = 0x0802AFFF;

/* Slots not configured */
define exported symbol  __ICFEDIT_SLOT_Active_2_header__= 0x00000000;
define exported symbol  __ICFEDIT_SLOT_Active_2_start__ = 0x00000000;
define exported symbol  __ICFEDIT_SLOT_Active_2_end__   = 0x00000000;
define exported symbol  __ICFEDIT_SLOT_Active_3_header__= 0x00000000;
define exported symbol  __ICFEDIT_SLOT_Active_3_start__ = 0x00000000;
define exported symbol  __ICFEDIT_SLOT_Active_3_end__   = 0x00000000;
define exported symbol  __ICFEDIT_SLOT_Dwl_2_start__    = 0x00000000;
define exported symbol  __ICFEDIT_SLOT_Dwl_2_end__      = 0x00000000;
define exported symbol  __ICFEDIT_SLOT_Dwl_3_start__    = 0x00000000;
define exported symbol  __ICFEDIT_SLOT_Dwl_3_end__      = 0x00000000;
