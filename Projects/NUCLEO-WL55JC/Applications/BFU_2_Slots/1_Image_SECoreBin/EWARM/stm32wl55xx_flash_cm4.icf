/*###ICF### Set of symbols used in SE and SB_SFU projects ****/

define memory mem with size = 4G;

/******************************************************************************/
/*       Include of SE symbols file                                           */
/*   (Project>Options>Linker>Extra Options --config_search option is used to  */
/*   specify the the directory to search for include files                    */
/******************************************************************************/
include "mapping_sbsfu.icf";
include "mapping_fwimg.icf";

initialize by copy { readwrite };
do not initialize  { section .noinit};

/******************************************************************************/
/*                          placement instructions                            */
/******************************************************************************/
place at address mem:__ICFEDIT_SE_CallGate_region_ROM_start__ { readonly section .SE_CallGate_Code };
place at address mem:__ICFEDIT_SE_Startup_region_ROM_start__ { readonly section .SE_Startup_Code};
place in SE_CODE_NOKEY_ROM_region {readonly};
place in SE_Key_ROM_region { readonly section .SE_embedded_Keys };
keep { section .SE_embedded_Keys };
place in SE_RAM_region {readwrite};
